## conf/distro/hygge.conf
```bitbake
require conf/distro/poky.conf

DISTRO = "hygge"
DISTRO_NAME = "Distro for the home-sweet-pi RaspberryPi images"
DISTRO_VERSION = "1.0.0"

DISTRO_FEATURES_append += " bluez5 bluetooth wifi systemd"
DISTRO_FEATURES_remove = "x11 wayland vulkan"

DISTRO_FEATURES_BACKFILL_CONSIDERED += "sysvinit"

VIRTUAL-RUNTIME_init_manager = "systemd"
VIRTUAL-RUNTIME_initscripts = "systemd-compat-units"

IMAGE_FEATURES += "ssh-server-dropbear"
CORE_IMAGE_EXTRA_INSTALL += "dhcp-client"

ENABLE_UART = "1"

RPI_EXTRA_CONFIG = " \n \
#Enable Raspberry Pi 7 display \n \
lcd_rotate=2 \n \
"
```

## conf/layer.conf
```bitbake
# We have a conf and classes directory, append to BBPATH
BBPATH .= ":${LAYERDIR}"

# We have a recipes directory containing .bb and .bbappend files, add to BBFILES
BBFILES += "${LAYERDIR}/recipes*/*/*.bb \
            ${LAYERDIR}/recipes*/*/*.bbappend"

BBFILE_COLLECTIONS += "homesweetpi"
BBFILE_PATTERN_homesweetpi := "^${LAYERDIR}/"
BBFILE_PRIORITY_homesweetpi = "9"

LAYERSERIES_COMPAT_homesweetpi = "thud warrior zeus"
```
